## configs/blankbrew_defconfig
```kconfig
#---------------------
# Custom RPI5 settings
#---------------------

# Chipset I guess
BR2_aarch64=y
BR2_cortex_a76=y

# Toolchain
BR2_TOOLCHAIN_EXTERNAL=y
BR2_TOOLCHAIN_EXTERNAL_BOOTLIN=y
BR2_TOOLCHAIN_EXTERNAL_BOOTLIN_AARCH64_GLIBC_STABLE=y

# Device config
BR2_TARGET_GENERIC_HOSTNAME="blankbrew"
BR2_TARGET_GENERIC_ISSUE="Is it brewday?"
BR2_TARGET_GENERIC_ROOT_PASSWD="platoon abbie piercing"
BR2_ROOTFS_USERS_TABLES="board/blankbrew/usertable.txt"
BR2_TARGET_TZ_INFO=y
BR2_TARGET_LOCALTIME="Asia/Shanghai"

# Raspberry Pi specicif Packages
BR2_PACKAGE_RPI_FIRMWARE_INSTALL_DTB_OVERLAYS=y
BR2_GLOBAL_PATCH_DIR="board/raspberrypi/patches"
BR2_PACKAGE_RPI_FIRMWARE=y
BR2_PACKAGE_RPI_FIRMWARE_CONFIG_FILE="board/blankbrew/config.txt"
BR2_PACKAGE_RPI_FIRMWARE_CMDLINE_FILE="board/blankbrew/cmdline.txt"

# Linux kernel
BR2_LINUX_KERNEL=y
BR2_LINUX_KERNEL_CUSTOM_TARBALL=y
BR2_LINUX_KERNEL_CUSTOM_TARBALL_LOCATION="$(call github,raspberrypi,linux,cd231d4775b14f228606c09f219b48308f6ab3aa)/linux-cd231d4775b14f228606c09f219b48308f6ab3aa.tar.gz"
BR2_LINUX_KERNEL_DEFCONFIG="bcm2712"
BR2_LINUX_KERNEL_CONFIG_FRAGMENT_FILES="board/blankbrew/rpi-gpu.fragment"
BR2_LINUX_KERNEL_DTS_SUPPORT=y
BR2_LINUX_KERNEL_INTREE_DTS_NAME="broadcom/bcm2712-rpi-5-b broadcom/bcm2712d0-rpi-5-b broadcom/bcm2712-rpi-500"
BR2_LINUX_KERNEL_NEEDS_HOST_OPENSSL=y
BR2_ROOTFS_DEVICE_CREATION_DYNAMIC_EUDEV=y


# Tools for creating the SD image
BR2_PACKAGE_HOST_GENIMAGE=y
BR2_PACKAGE_HOST_KMOD_XZ=y
BR2_PACKAGE_HOST_MTOOLS=y

# Filesystem / image
BR2_TARGET_ROOTFS_EXT2=y
BR2_TARGET_ROOTFS_EXT2_4=y
BR2_TARGET_ROOTFS_EXT2_SIZE="1024M"
BR2_ROOTFS_OVERLAY="board/blankbrew/overlay"
BR2_ROOTFS_POST_BUILD_SCRIPT="board/blankbrew/post-build.sh"
BR2_ROOTFS_POST_IMAGE_SCRIPT="board/raspberrypi5/post-image.sh"

# WPE Webkit and cog
BR2_PACKAGE_WPEWEBKIT=y
BR2_PACKAGE_COG=y
BR2_PACKAGE_WPEBACKEND_FDO=y
BR2_PACKAGE_COG_PLATFORM_DRM=y
BR2_PACKAGE_COG_PLATFORM_FDO=n
BR2_PACKAGE_EUDEV=y


# Serving react/vite app locally
BR2_PACKAGE_LIGHTTPD=y

# GPU related
BR2_PACKAGE_MESA3D=y
BR2_PACKAGE_MESA3D_GALLIUM_DRIVER_V3D=y
BR2_PACKAGE_MESA3D_OPENGL_ES=y


# Networking
BR2_SYSTEM_DHCP=""
BR2_PACKAGE_WPA_SUPPLICANT=y
BR2_PACKAGE_BRCMFMAC_SDIO_FIRMWARE_RPI=y
BR2_PACKAGE_BRCMFMAC_SDIO_FIRMWARE_RPI_WIFI=y
BR2_PACKAGE_DROPBEAR=y

# Various others
BR2_PACKAGE_HTOP=y
BR2_PACKAGE_STRACE=y
BR2_PACKAGE_NANO=y

# more various others lel
BR2_PACKAGE_BUSYBOX_SHOW_OTHERS=y
BR2_PACKAGE_BUSYBOX_CONFIG_FRAGMENT_FILES=y
BR2_PACKAGE_XZ=y
BR2_PACKAGE_KMOD=y
BR2_PACKAGE_KMOD_TOOLS=y
BR2_PACKAGE_HOST_DOSFSTOOLS=y
BR2_DOWNLOAD_FORCE_CHECK_HASHES=y
```
